## conf/distro/eca.conf
```bitbake
require ${COREBASE}/meta/conf/distro/defaultsetup.conf

DISTRO_VERSION = "0.5+snapshot-${DATE}"

VIRTUAL-RUNTIME_init_manager = "systemd"
VIRTUAL-RUNTIME_initscripts = ""

include conf/distro/include/default-providers-eca.inc

DISTRO_FEATURES += " bluetooth systemd 3g wifi ipv6 nfc zeroconf "

LAYER_CONF_VERSION = "6"

MACHINE_ESSENTIAL_EXTRA_RDEPENDS = ""

DISTRO_FEATURES_BACKFILL_CONSIDERED="sysvinit"

# Enable some of the supported VPN technogies in ConnMan
PACKAGECONFIG_append_pn-connman = " openvpn l2tp pptp"
```

## conf/distro/include/eca-floating-revisions.inc
```bitbake
#
# Package Versions for cutting edge testing:
#

SRCREV_pn-connman ?= "${AUTOREV}"
SRCREV_pn-bluez5 ?= "${AUTOREV}"
SRCREV_pn-ofono ?= "${AUTOREV}"
SRCREV_pn-neard ?= "${AUTOREV}"
```

## meta-eca-bsp/conf/layer.conf
```bitbake
# We have a conf and classes directory, add to BBPATH
BBPATH .= ":${LAYERDIR}"

# We have recipes-* directories, add to BBFILES
BBFILES += "${LAYERDIR}/recipes-*/*/*.bb \
            ${LAYERDIR}/recipes-*/*/*.bbappend"

# Clanton has own kernel recipe
BBFILES_quark += "${LAYERDIR}/recipes-*/*/quark/*.bbappend"

BBFILE_COLLECTIONS += "ecabsp"
BBFILE_PATTERN_ecabsp = "^${LAYERDIR}/"
BBFILE_PRIORITY_ecabsp = "5"
```

## meta-eca/conf/distro/eca-bleeding.conf
```bitbake
PREFERRED_VERSION_connman ?= "1.x+git%"
PREFERRED_VERSION_ofono ?= "1.x+git%"
PREFERRED_VERSION_neard ?= "0.x+git%"
PREFERRED_VERSION_bluez5 ?= "5.x+git%"
PREFERRED_VERSION_libasound-module-bluez ?= "5.x+git%"

require conf/distro/include/eca-floating-revisions.inc
require conf/distro/eca.conf

DISTRO = "eca-bleeding"
DISTROOVERRIDES = "eca"
```

## meta-eca/conf/distro/eca-graphics.conf
```bitbake
DISTRO_NAME = "Embedded Connectivity Appliance"
DISTRO_VERSION = "0.9+snapshot-${DATE}"

VIRTUAL-RUNTIME_init_manager = "systemd"
VIRTUAL-RUNTIME_initscripts = ""

include conf/distro/include/default-providers-eca.inc

DISTRO_FEATURES_append = " bluez5 systemd 3g wifi ipv6 nfc zeroconf \
	largefile multiarch x11 opengl wayland desktop"

LAYER_CONF_VERSION = "6"

MACHINE_ESSENTIAL_EXTRA_RDEPENDS = ""

DISTRO_FEATURES_BACKFILL_CONSIDERED="sysvinit"

# Enable some of the supported VPN technogies in ConnMan
PACKAGECONFIG_append_pn-connman = " openvpn l2tp pptp"

# Use bluez5 in pulseaudio
PACKAGECONFIG_append_pn-pulseaudio = " bluez5"

INHERIT += "extrausers"
EXTRA_USERS_PARAMS = "usermod -p '\$1\$1DO/lR8M\$f8JOOu4W8GBZzdNzCgSW40' root;"

LICENSE_FLAGS_WHITELIST = "commercial"

FEATURE_PACKAGES_eca-desktop = "packagegroup-eca-desktop"

IMAGE_FEATURES += "splash x11-base eca-desktop hwcodecs"

#CORE_IMAGE_EXTRA_INSTALL += "wayland weston"
```

## meta-eca/conf/distro/eca.conf
```bitbake
DISTRO_NAME = "Embedded Connectivity Appliance"
DISTRO_VERSION = "0.9+snapshot-${DATE}"

VIRTUAL-RUNTIME_init_manager = "systemd"
VIRTUAL-RUNTIME_initscripts = ""

include conf/distro/include/default-providers-eca.inc

DISTRO_FEATURES_append = " bluetooth systemd 3g wifi ipv6 nfc zeroconf"

LAYER_CONF_VERSION = "6"

MACHINE_ESSENTIAL_EXTRA_RDEPENDS = ""

DISTRO_FEATURES_BACKFILL_CONSIDERED="sysvinit"

# Enable some of the supported VPN technogies in ConnMan
PACKAGECONFIG_append_pn-connman = " openvpn l2tp pptp"

INHERIT += "extrausers"
EXTRA_USERS_PARAMS = "usermod -p '\$1\$1DO/lR8M\$f8JOOu4W8GBZzdNzCgSW40' root;"

include conf/distro/include/eca-edison.inc

# We have Broadcom bcm43340 wifi only in Edison
BBMASK .= "${@base_contains("MACHINE", "edison", "", "|meta-eca/meta-eca/recipes-kernel/bcm43340/", d)}"

# Use standard u-boot for Beaglebone
BBMASK .= "${@base_contains("MACHINE", "beaglebone", "|meta-eca/meta-eca-bsp/recipes-bsp/u-boot/", "", d)}"

# eca-image.bbappend has only stuff for edison or quark so mask those
# recipes away otherwise
BBMASK .= "${@base_contains("MACHINE", "edison quark", "", "|meta-eca/meta-eca-bsp/recipes-eca/images/", d)}"
```

## meta-eca/conf/distro/include/default-providers-eca.inc
```bitbake
#
# Default virtual providers
#
PREFERRED_PROVIDER_virtual/arm-oe-linux-gnueabi-depmod ?= "kmod-cross"
PREFERRED_PROVIDER_udev ?= "systemd"
PREFERRED_PROVIDER_udev-utils ?= "systemd"

PREFERRED_PROVIDER_virtual/kernel ?= "linux-yocto"
PREFERRED_VERSION_linux-yocto ?= "3.14%"

# Try to use as new usb-modeswitch as possible
PREFERRED_VERSION_usb-modeswitch-data ?= "20150115"
```

## meta-eca/conf/distro/include/eca-edison.inc
```bitbake
# Some edison specific defaults
PREFERRED_PROVIDER_virtual/kernel_edison = "linux-yocto"
PREFERRED_VERSION_linux-yocto_edison = "3.10%"
PREFERRED_PROVIDER_virtual/bootloader_edison = "u-boot"
PREFERRED_VERSION_u-boot_edison = "v2014.04%"
PREFERRED_VERSION_u-boot-fw-utils_edison = "v2014.04%"
PREFERRED_VERSION_openssl_edison = "1.0.1g%"
IMAGE_ROOTFS_SIZE_edison = "473088"

# The kernel does not boot if newer gcc is used
GCCVERSION_edison = "4.8%"
SDKGCCVERSION_edison = "${GCCVERSION}"
```

## meta-eca/conf/distro/include/eca-rpi.inc
```bitbake
# Some raspberrypi specific defaults

PREFERRED_VERSION_linux-raspberrypi_raspberrypi ?= "4.1%"
PREFERRED_VERSION_linux-raspberrypi_raspberrypi2 ?= "4.1%"

#PREFERRED_PROVIDER_virtual/bootloader_raspberrypi = "u-boot-rpi"
#PREFERRED_PROVIDER_virtual/bootloader_raspberrypi2 = "u-boot-rpi"

#KERNEL_IMAGETYPE_raspberrypi = "uImage"
#KERNEL_IMAGETYPE_raspberrypi2 = "uImage"

#IMAGE_BOOTLOADER_raspberrypi = "u-boot-rpi"
#IMAGE_BOOTLOADER_raspberrypi2 = "u-boot-rpi"
```
